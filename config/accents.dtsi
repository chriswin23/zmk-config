/*
*
* Copyright (c) 2022 Rafael Romão
* SPDX-License-Identifier: MIT
*
*/

#include <behaviors.dtsi>
#include <dt-bindings/zmk/keys.h>
#include <dt-bindings/zmk/bt.h>

/ {
    #define ACCENTED_KEY(NAME, LABEL_U, LABEL_L, LABEL, KEY, DEAD_KEY) \
        ac_##NAME##_l: ac_##NAME##_l { \
            wait-ms = <0>; \
            tap-ms = <0>; \
            label = LABEL_L; \
            compatible = "zmk,behavior-macro"; \
            #binding-cells = <0>; \
            bindings \
                = <&macro_press &kp RALT> \
                , <&macro_tap &kp DEAD_KEY> \
                , <&macro_release &kp RALT> \
                , <&macro_tap &kp KEY> \
                ; \
        }; \
        ac_##NAME##_u: ac_##NAME##_u { \
            wait-ms = <0>; \
            tap-ms = <0>; \
            label = LABEL_U; \
            compatible = "zmk,behavior-macro"; \
            #binding-cells = <0>; \
            bindings \
                = <&macro_release &kp LSHFT> \
                , <&macro_press &kp RALT> \
                , <&macro_tap &kp DEAD_KEY> \
                , <&macro_release &kp RALT> \
                , <&macro_press &kp LSHFT> \
                , <&macro_tap &kp KEY> \
                , <&macro_release &kp LSHFT> \
                ; \
        }; \
        ac_##NAME: ac_##NAME { \
            label = LABEL; \
            compatible = "zmk,behavior-mod-morph"; \
            #binding-cells = <0>; \
            bindings = <&ac_##NAME##_l>, <&ac_##NAME##_u>; \
            mods = <(MOD_LSFT|MOD_RSFT)>; \
            keep-mods = <(MOD_LSFT|MOD_RSFT)>; \
        };

    accents {
        ACCENTED_KEY(agrv, "à", "À", "àÀ", A, GRAVE)
        ACCENTED_KEY(aacu, "á", "Á", "áÁ", A, SQT)
        ACCENTED_KEY(atil, "ã", "Ã", "ãÃ", A, TILDE)
        ACCENTED_KEY(acir, "â", "Â", "âÂ", A, CARET)
        ACCENTED_KEY(auml, "ä", "Ä", "äÄ", A, DQT)
        ACCENTED_KEY(eacu, "é", "É", "éÉ", E, SQT)
        ACCENTED_KEY(ecir, "ê", "Ê", "êÊ", E, CARET)
        ACCENTED_KEY(egrv, "è", "È", "èÈ", E, GRAVE)
        ACCENTED_KEY(iacu, "í", "Í", "íÍ", I, SQT)
        ACCENTED_KEY(icir, "î", "Î", "îÎ", I, CARET)
        ACCENTED_KEY(oacu, "ó", "Ó", "óÓ", O, SQT)
        ACCENTED_KEY(otil, "õ", "Õ", "õÕ", O, TILDE)
        ACCENTED_KEY(ouml, "ö", "Ö", "öÖ", O, DQT)
        ACCENTED_KEY(ocir, "ô", "Ô", "ôÔ", O, CARET)
        ACCENTED_KEY(uacu, "ú", "Ú", "úÚ", U, SQT)
        ACCENTED_KEY(ugrv, "ù", "Ù", "ùÙ", U, GRAVE)
        ACCENTED_KEY(uuml, "ü", "Ü", "üÜ", U, DQT)
        ACCENTED_KEY(ucir, "û", "Û", "ûÛ", U, CARET)

        ac_ccdi: ac_ccdi {
            wait-ms = <0>;
            tap-ms = <0>;
            label = "ç";
            compatible = "zmk,behavior-macro";
            #binding-cells = <0>;
            bindings
                = <&macro_press &kp RALT>
                , <&macro_tap &kp C>
                , <&macro_release &kp RALT>
                ;
        };
    };
};
